## application/edge_agent/main/Kconfig.projbuild
```kconfig
menu "App Config"

menu "Default Wi-Fi Settings"

    config APP_WIFI_SSID
        string "Default Wi-Fi SSID"
        default ""
        help
            Default Wi-Fi SSID used to populate app settings.

    config APP_WIFI_PASSWORD
        string "Default Wi-Fi password"
        default ""
        help
            Default Wi-Fi password used to populate app settings.

    config APP_WIFI_AP_SSID_PREFIX
        string "Provisioning AP SSID prefix"
        default "esp-claw"
        help
            Prefix used to build the unique provisioning AP SSID. The full
            SSID is "<prefix>-<MAC[3..5]>" (e.g. esp-claw-84AEE5).

    config APP_WIFI_AP_CHANNEL
        int "Provisioning AP channel"
        range 1 13
        default 1
        help
            Channel used by the provisioning SoftAP.

    config APP_WIFI_AP_MAX_CONN
        int "Provisioning AP max connections"
        range 1 10
        default 4
        help
            Maximum number of concurrent stations on the provisioning AP.

    config APP_WIFI_MAX_RETRY
        int "STA max retries before AP fallback"
        range 1 20
        default 5
        help
            After this many consecutive STA connection failures the device
            falls back to pure AP mode and waits for the user to provision
            new credentials.

    config APP_SEARCH_TAVILY_KEY
        string "Default Tavily Search API key"
        default ""
        help
            Default Tavily search API key used to populate app settings.

endmenu

endmenu

menu "Video Player Configuration"
    config VIDEO_PLAYER_ENABLE
        bool "Enable SD Card Video Player"
        default y
        help
            Enable boot-time SD card video scanning and MP4/AVI looping playback.

    config VIDEO_PLAYER_AUDIO_ENABLE
        bool "Enable audio playback for videos"
        default y
        depends on VIDEO_PLAYER_ENABLE && ESP_BOARD_DEV_AUDIO_CODEC_SUPPORT
        help
            Enable audio track playback for video files via ES8311 codec.

    config VIDEO_PLAYER_SYNC_ENABLED
        bool "Enable Audio-Video Synchronization"
        default y
        depends on VIDEO_PLAYER_AUDIO_ENABLE
        help
            Enable synchronization between audio and video playback.
endmenu
```

## boards/espressif/esp32_p4_wifi6_touch_lcd_4_3/sdkconfig.defaults.board
```kconfig
CONFIG_ESPTOOLPY_FLASHMODE_QIO=y
CONFIG_ESPTOOLPY_FLASHFREQ_40M=y
CONFIG_ESPTOOLPY_FLASHSIZE_32MB=y
CONFIG_SPIRAM=y
CONFIG_SPIRAM_MODE_HEX=y
CONFIG_SPIRAM_SPEED_200M=y

# LCD Configuration
CONFIG_BSP_LCD_CONTROLLER_ST7701=y
CONFIG_LCD_PIXEL_FORMAT_RGB565=y

# USB Console - enable both UART and USB-Serial-JTAG for debugging
CONFIG_ESP32P4_SELECTS_REV_LESS_V3=y
CONFIG_ESP_CONSOLE_UART=y
CONFIG_ESP_CONSOLE_UART_NUM=0
CONFIG_ESP_CONSOLE_SECONDARY_USB_SERIAL_JTAG=y
CONFIG_ESP_CONSOLE_USB_SERIAL_JTAG_ENABLED=y

# USB UAC Audio Configuration
CONFIG_UAC_SPEAKER_CHANNEL_NUM=2
CONFIG_UAC_MIC_CHANNEL_NUM=2
```
